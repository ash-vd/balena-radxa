## layers/meta-balena-rockchip/conf/layer.conf
```bitbake
BBPATH .= ":${LAYERDIR}"

BBFILES += "${LAYERDIR}/recipes-*/*/*.bb \
            ${LAYERDIR}/recipes-*/*/*.bbappend"

BBFILE_COLLECTIONS += "balena-rockchip"
BBFILE_PATTERN_balena-rockchip := "^${LAYERDIR}/"
BBFILE_PRIORITY_balena-rockchip = "1337"


# we do not use Rockchip's old 2017.09 u-boot
BBMASK += "meta-rockchip/recipes-bsp/u-boot"

# mask BSP patch which fails to apply and which we have no use for
# BBMASK += "meta-rockchip/recipes-core/systemd/systemd"

LAYERSERIES_COMPAT_balena-rockchip = "kirkstone"
```
